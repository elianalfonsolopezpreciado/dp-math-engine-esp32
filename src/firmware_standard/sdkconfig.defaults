## src/firmware_standard/sdkconfig.defaults
```kconfig
CONFIG_ESP_DEFAULT_CPU_FREQ_MHZ_240=y
CONFIG_FREERTOS_UNICORE=n
CONFIG_COMPILER_OPTIMIZATION_PERF=y
CONFIG_MBEDTLS_ASYMMETRIC_CONTENT_LEN=n
CONFIG_PM_ENABLE=n
```
